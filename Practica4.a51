;PRACTICA 4
;P2: BUS DE DATOS DE LCD
;P3.6: RS - LCD
;P3.7: E - LCD

;P1:3 - P1.0: D - A DE 74C922

;P3.1: PUERTO SERIAL
;P3.2: LECTURA DE MATRIZ
;P3.3: ASCII MODE

;TIMER 1 - DELAY 100 us

;R7: N VECES QUE SE REPITE TIMER 100 uS
;R6: CANTIDAD DE CARACTERES impresos (LCD)
;R5: CARACTER PRUEBA

DIR_DATOS equ 60H
DIR_CONVERTION equ 0200H
RS equ P3.6
E equ P3.7

ORG 0H
	SJMP START
	
;EXTERNAL 0
ORG 0003H
	CLR IE0
	;Leer dato
	ACALL READ_MATRICIAL
	
	;Imprimir dato
	ACALL LCD_WRITE	
	
	;Guardar dato
	ACALL SAVE_DATA
	
RETI
	
;TIMER 0
;ORG 000BH
;RETI

;EXTERNAL 1
ORG 0013H
RETI

;TIMER 1
;ORG 001BH
;RETI

;SERIAL PORT
ORG 0023H
RETI
	

ORG 40H
START:
;CONF TIMER
;				T1					T0	
;			GATE !T/C M1 M0		GATE !T/C M1 M0	
	MOV TMOD, #00010001b
	
;CONF INTERRUPCIONES
;		EA - ET2 ES ET1 EX1 ET0 EX0
MOV IE, #10010101b
setb it0
MOV R0, #DIR_DATOS

;CONF SERIAL


	ACALL LCD_INICIALIZATION
	
TEST:
	;PUEDEN UTILIZAR ESTE ESPACIO PARA PRUEBAS, SIEMPRE Y CUANDO DEJEN EL CODIGO COMO DEBERÍA IR.
	
	SJMP $
	
	
LCD_INICIALIZATION:
	;38H - 39 us, RS = 0
	;0FH - 39 us, RS = 0
	;01H - 1.53 ms, RS = 0
	CLR RS; !COMANDO / DATO
	CLR E
	MOV P2, #01H
	MOV R7, #17D
	SETB E ; E 
	ACALL DELAY
	CLR E; E	

	MOV P2, #38H
	MOV R7, #01h; cantidad de veces que se repite t_0
	SETB E; E 
	ACALL DELAY
	CLR E; E
	
	MOV P2, #38H
	MOV R7, #01h
	SETB E ; E 
	ACALL DELAY
	CLR E; E
	
	MOV P2, #0FH
	MOV R7, #01h
	SETB E; E 
	ACALL DELAY
	CLR E; E

	MOV P2, #80H
	MOV R7, #01h
	SETB E; E 
	ACALL DELAY
	CLR E; E

	RET
	
LCD_WRITE:
;PARA ESCRIBIR EN LCD, PASAR AL ACC EL CARACTER A ESCRIBIR
	CJNE R6, #16D, LCD_WRITE_ACC
	ACALL LCD_JUMP
	MOV R6, #0H
	
LCD_WRITE_ACC:
	SETB RS; !COMANDO / DATO
	MOV P2, A; MOVER AL BUS DE LA PANTALLA EL DATO
	SETB E; E
	MOV R7, #1
	ACALL DELAY
	CLR E
	INC R6

	RET
	
LCD_JUMP:
	CLR RS
	MOV P2, #0C0H
	SETB E
	MOV R7, #1D
	ACALL DELAY
	CLR E
	RET
	
DELAY:
	MOV TH0, #HIGH(-100)
	MOV TL0, #LOW(-100)
	SETB TR0
	
POOLING:
	JNB TF0, POOLING
	CLR TF0
	
	DJNZ R7, DELAY
	
	RET
	
READ_MATRICIAL:
	mov A,P1; leer dato
	anl A,#0FH; limpiar 
	MOV DPH, #HIGH(DIR_CONVERTION)
	MOV DPL, #LOW(DIR_CONVERTION)
	
	MOVC A, @A+DPTR; Mover al acc la conversión
	
	RET
	
SAVE_DATA:
	mov @R0, A
	INC R0
	RET

	ORG DIR_CONVERTION
	DB 'D'	;0
	DB 'B'	;1
	DB 'C'	;2
	DB 'A'	;3
	DB '0'	;4
	DB '5'	;5
	DB '8'	;6
	DB '2'	;7
	DB 'E'	;8
	DB '6'	;9
	DB '9'	;10
	DB '3'	;11
	DB 'F'	;12
	DB '4'	;13
	DB '7'	;14	
	DB '1'	;15
		
		
	
	END